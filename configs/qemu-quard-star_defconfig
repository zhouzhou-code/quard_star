## configs/qemu-quard-star_defconfig
```kconfig
#qemu-quard-star_defconfig 内容如下： 和 qemu-riscv64_smode_defconfig(默认的s模式的defconfig)对比分析
#一样的
CONFIG_RISCV=y
#特有的，我们只有一块DRAM                  
CONFIG_NR_DRAM_BANKS=1   
#一样的        
CONFIG_ENV_SIZE=0x20000
#特有的，平台名称        
CONFIG_TARGET_QEMU_QUARD_STAR=y
#一样的 
CONFIG_ARCH_RV64I=y
#一样的             
CONFIG_RISCV_SMODE=y
#一样的            
CONFIG_DISTRO_DEFAULTS=y
#一样的        
CONFIG_FIT=y     
#一样的               
CONFIG_DISPLAY_CPUINFO=y 
#一样的       
CONFIG_DISPLAY_BOARDINFO=y 
#一样的，自检EFI子系统     
CONFIG_CMD_BOOTEFI_SELFTEST=y   
#一样的，EFI下NVM编辑命令
CONFIG_CMD_NVEDIT_EFI=y         

#特有的，优先使用早期阶段提供的设备树；优先使用前一级引导程序/固件提供的设备树（FDT）”。
#启用后，U‑Boot 在早期初始化会采用固件(例如 OpenSBI)通过 fdtcontroladdr 传入的 FDT，
#而不是强制从存储或内置默认DTB重新加载或替换它
CONFIG_OF_PRIOR_STAGE=y         

#启用环境变量重定位时的GD结构体支持
#在重定位时，环境变量的地址会更新到 GD 结构体中
CONFIG_SYS_RELOC_GD_ENV_ADDR=y #特有的

#一样的; MTD（Memory Technology Device）是 Flash 设备的通用抽象层
CONFIG_DM_MTD=y              


#作者原来没提供，但是uboot新版一定要指定？先加上?不，好像在板级的.h文件里加上了！
CONFIG_SYS_LOAD_ADDR=0x80200000
#不需要CONFIG_SYS_MAX_FLASH_BANKS表示最大的flash存储体数吗？
```

## source/u-boot-2026.01/configs/qemu-riscv64_smode_defconfig
```kconfig
# 启用 RISC-V 架构支持
CONFIG_RISCV=y

# 设置动态内存分配器的大小为 8MB（0x800000 字节）
# 这决定了 U-Boot 运行时可以动态分配的最大内存量
CONFIG_SYS_MALLOC_LEN=0x800000

# 启用自定义的初始栈指针地址设置
CONFIG_HAS_CUSTOM_SYS_INIT_SP_ADDR=y
# 设置自定义的初始栈指针地址为 0x80200000,系统启动时，栈指针将从这个地址开始向下增长
CONFIG_CUSTOM_SYS_INIT_SP_ADDR=0x80200000

# 设置环境变量存储区大小为 128KB（0x20000 字节）
CONFIG_ENV_SIZE=0x20000

# 设置默认设备树文件名为 "qemu-virt64.dtb"， U-Boot 会尝试加载这个设备树文件来描述硬件
CONFIG_DEFAULT_DEVICE_TREE="qemu-virt64"

# 设置默认的加载地址为 0x80200000; 当加载内核、设备树等文件时，如果没有指定地址，会使用这个地址
CONFIG_SYS_LOAD_ADDR=0x80200000

# 启用 QEMU 虚拟平台的目标板支持
CONFIG_TARGET_QEMU_VIRT=y

# 启用 RISC-V 64 位基础指令集（RV64I）
CONFIG_ARCH_RV64I=y

# 启用 Supervisor 模式（S模式）支持；U-Boot将运行在 RISC-V 的 Smode下
CONFIG_RISCV_SMODE=y

# 启用 FIT（Flattened Image Tree）扁平镜像树 格式支持
# FIT 是一种灵活的镜像格式，可以在一个镜像中包含内核、设备树、ramdisk等多个组件
CONFIG_FIT=y

# 启用发行版默认配置
# 这会启用一些常见的发行版需要的功能，如网络启动、ext4 支持等
CONFIG_DISTRO_DEFAULTS=y

# 启用预启动命令
# 在启动过程中，会在执行 bootcmd 之前执行预定义命令
CONFIG_USE_PREBOOT=y

# 设置预启动命令
# 这里设置环境变量 fdt_addr 并初始化设备树
CONFIG_PREBOOT="setenv fdt_addr ${fdtcontroladdr}; fdt addr ${fdtcontroladdr};"

# 启用显示 CPU 信息
# 启动时会显示 CPU 型号、频率等信息
CONFIG_DISPLAY_CPUINFO=y

# 启用显示板卡信息
# 启动时会显示板卡名称、制造商等信息
CONFIG_DISPLAY_BOARDINFO=y

# 禁用板级初始化（注释掉表示不启用）
# 如果板子需要特殊的初始化代码，可以启用这个选项
# CONFIG_BOARD_INIT is not set

# 启用 EFI 自测命令
# 添加 bootefi selftest 命令，用于测试 EFI 子系统
CONFIG_CMD_BOOTEFI_SELFTEST=y

# 启用 EFI 环境下的 NVM 编辑命令
# 添加 nvedit 命令的 EFI 扩展支持
CONFIG_CMD_NVEDIT_EFI=y

# MII 命令用于管理 MII 兼容的网络 PHY
# CONFIG_CMD_MII is not set

# 启用生成新进程命令
# 添加 spawn 命令，可以加载并执行一个独立的应用程序
CONFIG_CMD_SPAWN=y

# 启用环境变量重定位时的GD结构体支持
# 在重定位时，环境变量的地址会更新到 GD 结构体中
CONFIG_ENV_RELOC_GD_ENV_ADDR=y

# 启用 MTD 设备模型支持
# MTD（Memory Technology Device）是 Flash 设备的通用抽象层
CONFIG_DM_MTD=y

# 设置Flash编程时不显示进度；值为0表示不显示进度，可以加快编程速度
CONFIG_FLASH_SHOW_PROGRESS=0

# 设置系统最大 Flash 存储体数为2；这定义了系统可以有多少个独立的 Flash 芯片/分区
CONFIG_SYS_MAX_FLASH_BANKS=2

# 启用用户态线程支持
# 允许在 U-Boot 中运行简单的多线程应用程序
CONFIG_UTHREAD=y

# 启用单元测试支持
# 这会编译并包含单元测试代码，可以通过命令运行测试
CONFIG_UNIT_TEST=y
```

## u-boot-2026.01/board/emulation/qemu-quard-star/Kconfig
```kconfig
if TARGET_QEMU_QUARD_STAR

config SYS_BOARD
    string
	default "qemu-quard-star"

config SYS_VENDOR
    string
	default "emulation"

config SYS_CPU
    string
	default "generic"

config SYS_CONFIG_NAME
    string
	default "qemu-quard-star"

config TEXT_BASE
    hex
	default 0xB0200000

config BOARD_SPECIFIC_OPTIONS # dummy
	def_bool y
	select GENERIC_RISCV
	select OF_CONTROL          
    select OF_HAS_PRIOR_STAGE  
	imply AHCI
	imply SMP
	imply BOARD_LATE_INIT 
	imply CMD_POWEROFF
	imply CMD_EXT2
	imply CMD_EXT4
	imply CMD_FAT
	imply CMD_FS_GENERIC
	imply DOS_PARTITION
	imply ISO_PARTITION
	imply EFI_PARTITION
	imply SYS_NS16550
	imply SIFIVE_SERIAL
	imply SYSRESET
	imply SYSRESET_CMD_POWEROFF
	imply SYSRESET_SYSCON

	imply QFW
    imply QFW_MMIO
    imply CMD_QFW

	imply VIRTIO
    imply VIRTIO_MMIO
    imply CMD_VIRTIO
	imply VIRTIO_PCI
	imply VIRTIO_NET
	imply VIRTIO_BLK


endif
```

## u-boot-2026.01/configs/qemu-quard-star_defconfig
```kconfig
# 启用 RISC-V 架构支持
CONFIG_RISCV=y

# 设置动态内存分配器的大小为 8MB（0x800000 字节）
# 这决定了 U-Boot 运行时可以动态分配的最大内存量
CONFIG_SYS_MALLOC_LEN=0x800000

# 早期内存malloc分配器大小为16KB（0x4000 字节）
# 这决定了 U-Boot 早期初始化阶段可以动态分配的最大
CONFIG_SYS_MALLOC_F_LEN=0x4000

# 启用自定义的初始栈指针地址设置(早期临时栈,重定位之前使用)
CONFIG_HAS_CUSTOM_SYS_INIT_SP_ADDR=y
CONFIG_CUSTOM_SYS_INIT_SP_ADDR=0xB1000000
CONFIG_STACK_SIZE_SHIFT=14


# 重定位之后的栈大小设置为1MB
CONFIG_STACK_SIZE=0x100000

# 设置环境变量存储区大小为 128KB（0x20000 字节）
CONFIG_ENV_SIZE=0x20000
 
# 设置默认的加载地址为 0x80200000; 当加载内核、设备树等文件时，如果没有指定地址，会使用这个地址
CONFIG_SYS_LOAD_ADDR=0x80200000

# 启用 QEMU Quard Star 目标支持
CONFIG_TARGET_QEMU_QUARD_STAR=y

# 启用 RISC-V 64 位基础指令集（RV64I）
CONFIG_ARCH_RV64I=y
# 启用 Supervisor 模式（S模式）支持；U-Boot将运行在 RISC-V 的 Smode下
CONFIG_RISCV_SMODE=y
# 启用 FIT（Flattened Image Tree）扁平镜像树 格式支持
# FIT 是一种灵活的镜像格式，可以在一个镜像中包含内核、设备树、ramdisk等多个组件
CONFIG_FIT=y

# DISTRO BOOT支持
CONFIG_DISTRO_DEFAULTS=y

# 启用预启动命令
# 在启动过程中，会在执行 bootcmd 之前执行预定义命令
CONFIG_USE_PREBOOT=y

# 设置预启动命令
# 这里设置环境变量 fdt_addr 并初始化设备树
CONFIG_PREBOOT="setenv fdt_addr ${fdtcontroladdr}; fdt addr ${fdtcontroladdr};"

# 启用显示 CPU 信息
# 启动时会显示 CPU 型号、频率等信息
CONFIG_DISPLAY_CPUINFO=y

# 启用显示板卡信息
# 启动时会显示板卡名称、制造商等信息
CONFIG_DISPLAY_BOARDINFO=y

# 禁用板级初始化（注释掉表示不启用）
# 如果板子需要特殊的初始化代码，可以启用这个选项
# CONFIG_BOARD_INIT is not set

# 启用 EFI 自测命令
# 添加 bootefi selftest 命令，用于测试 EFI 子系统
CONFIG_CMD_BOOTEFI_SELFTEST=y

# 启用 EFI 环境下的 NVM 编辑命令
# 添加 nvedit 命令的 EFI 扩展支持
CONFIG_CMD_NVEDIT_EFI=y

# MII 命令用于管理 MII 兼容的网络 PHY
# CONFIG_CMD_MII is not set

# 启用环境变量重定位时的GD结构体支持
# 在重定位时，环境变量的地址会更新到 GD 结构体中
CONFIG_ENV_RELOC_GD_ENV_ADDR=y

# 启用 MTD 设备模型支持
# MTD（Memory Technology Device）是 Flash 设备的通用抽象层
CONFIG_DM_MTD=y

# 设置Flash编程时不显示进度；值为0表示不显示进度，可以加快编程速度
CONFIG_FLASH_SHOW_PROGRESS=0

# 设置系统最大 Flash 存储体数为1；这定义了系统可以有多少个独立的 Flash 芯片/分区
CONFIG_SYS_MAX_FLASH_BANKS=1

# 启用单元测试支持
# 这会编译并包含单元测试代码，可以通过命令运行测试
CONFIG_UNIT_TEST=y
```
